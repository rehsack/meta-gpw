## conf/distro/gpw.conf
```bitbake
PACKAGE_CLASSES ?= "package_ipk"
USER_CLASSES ?= "buildstats image-mklibs image-prelink"

OVERLAY_SHADOWS=".shadow/.etc,.shadow/.home,.work/.etc,.work/.home"
OVERLAY ?= "#"
OVERLAYFS ?= "#"
UNIONFS ?= "#"

# Additional license directories.
# LICENSE_PATH += "${LAYERDIR}/custom-licenses"

DEFAULT_TIMEZONE="Europe/Berlin"

# aa-dj af-za ak-gh an-es anp-in ar-ae ar-bh ar-dz ar-eg ar-in ar-iq ar-jo ar-kw ar-lb ar-ly ar-ma ar-om ar-qa ar-sa ar-sd ar-ss ar-sy ar-tn ar-ye as-in ast-es ayc-pe az-az be-by bem-zm ber-dz ber-ma bg-bg bho-in bn-in bo-cn bo-in br-fr brx-in bs-ba ca-ad ca-es ca-fr ca-it cmn-tw crh-ua cs-cz csb-pl cv-ru cy-gb da-dk de-at de-be de-ch de-de de-lu doi-in dv-mv dz-bt el-cy el-gr en-ag en-au en-bw en-ca en-dk en-gb en-hk en-ie en-in en-ng en-nz en-ph en-sg en-us en-za en-zm en-zw es-ar es-bo es-cl es-co es-cr es-cu es-do es-ec es-es es-gt es-hn es-mx es-ni es-pa es-pe es-pr es-py es-sv es-us es-uy es-ve et-ee eu-es fa-ir ff-sn fi-fi fil-ph fo-fo fr-be fr-ca fr-ch fr-fr fr-lu fur-it fy-de fy-nl ga-ie gd-gb gl-es gu-in gv-gb ha-ng hak-tw he-il hi-in hne-in hr-hr hsb-de ht-ht hu-hu hy-am ia-fr id-id ig-ng ik-ca is-is it-ch it-it iu-ca iw-il ja-jp ka-ge kk-kz kl-gl km-kh kn-in ko-kr kok-in ks-in ku-tr kw-gb ky-kg lb-lu lg-ug li-be li-nl lij-it lo-la lt-lt lv-lv lzh-tw mag-in mai-in mg-mg mhr-ru mi-nz mk-mk ml-in mni-in mr-in ms-my mt-mt my-mm nan-tw nb-no nds-de nds-nl ne-np nhn-mx niu-nu niu-nz nl-aw nl-be nl-nl nn-no nr-za nso-za oc-fr om-ke or-in os-ru pa-in pa-pk pap-an pap-aw pap-cw pl-pl ps-af pt-br pt-pt quz-pe ro-ro ru-ru ru-ua rw-rw sa-in sat-in sc-it sd-in se-no shs-ca si-lk sk-sk sl-si so-dj so-ke so-so sq-al sq-mk sr-me sr-rs ss-za st-za sv-fi sv-se sw-ke sw-tz szl-pl ta-in ta-lk tg-tj th-th the-np tk-tm tl-ph tn-za tr-cy ts-za tt-ru ug-cn uk-ua unm-us ur-in ur-pk uz-uz ve-za vi-vn wa-be wae-ch wo-sn xh-za yi-us yo-ng yue-hk zh-cn zh-hk zh-sg zh-tw zu-za
IMAGE_LINGUAS="en-us de-de "
#IMAGE_LINGUAS = "en-us en-gb pt-br de-de"

require conf/distro/updatable.conf

DISTRO_FEATURES:remove = " pcmcia phone irda usbgadget 3g nfc cramfs ppp"
DISTRO_FEATURES:remove = " bluetooth bluez5 pci x11 wayland"

PACKAGECONFIG:remove = " consolekit x11 xvmc wayland dri3 xa gallium cups ldap dbus"
PACKAGECONFIG:append_pn-system-image-update-webui = " nginx-proxy"
PACKAGECONFIG:append_pn-s6-networking = " bearssl"
PACKAGECONFIG:append_pn-busybox = " procps"
PREFERRED_RPROVIDER_procps = "busybox"

SUPERVISION_TYPE = "s6"
PREFERRED_PROVIDER_virtual/supervision = "s6"
#SUPERVISION_TYPE = "daemontools"
#PREFERRED_PROVIDER_virtual/supervision = "daemontools"

UPDATABLE_IMAGE_CLASSES = "gpw-image-extra"

UPDATABLE_KEY_FILE ?= "${GPW_EXAMPLES_CERT_DIR}/dev/private/development-1.key.pem"
UPDATABLE_CERT_FILE ?= "${GPW_EXAMPLES_CERT_DIR}/dev/development-1.cert.pem"

DISTRO = "gpw"
DISTROOVERRIDES:append = ":poky"
DISTRO_NAME = "German Perl Workshop"
DISTRO_BASE_VERSION = "3.3"
DISTRO_VERSION = "3.3.0"
DISTRO_CODENAME = "gatesgarth"
```

## conf/layer.conf
```bitbake
# We have a conf and classes directory, add to BBPATH
BBPATH .= ":${LAYERDIR}"

# We have a recipes-* directories, add to BBFILES
BBFILES += "${LAYERDIR}/recipes-*/*/*.bb \
            ${LAYERDIR}/recipes-*/*/*.bbappend"

BBFILE_COLLECTIONS += "gpw-examples"
BBFILE_PATTERN_gpw-examples = "^${LAYERDIR}/"
BBFILE_PRIORITY_gpw-examples = "13"

# This should only be incremented on significant changes that will
# cause compatibility issues with other layers
LAYERVERSION_gpw-examples = "2"

LAYERDEPENDS_gpw-examples = "core openembedded-layer cpan-layer jens-playground"
LAYERSERIES_COMPAT_gpw-examples = "thud warrior zeus dunfell"
```

## conf/machine/include/wendy-container.inc
```bitbake
# The disk layout (in blocks) used is:
#  blocks                           KiB
#     0x0 +-----------------------+    0x0
#         | MBR / GPT ...         |
#   0x100 +-----------------------+   0x80
#         | Primary SPL           |
#   0x200 +-----------------------+  0x100
#         | Secondary SPL         |
#   0x300 +-----------------------+  0x180
#         | Primary U-Boot (TPL)  |
#  0x1000 +-----------------------+ 0x0800
#         | /boot                 |
#  0x2800 +-----------------------+ 0x1400
#         | / (app)               |
#  0x3000 +-----------------------+ 0x1800
#         | / (update)            |
#  0x3000 +-----------------------+ 0x1800
#         | /data                 |
#  0x3000 +-----------------------+ 0x1800

UPDATABLE_BUNDLE_HOOKS = "appboot prepare_overlay uboot_setenv unique_deploy"

UPDATABLE_BUNDLE_HOOK_unique_deploy[type] = "inline"
UPDATABLE_BUNDLE_HOOK_unique_deploy[trigger] = "postverify"
UPDATABLE_BUNDLE_HOOK_unique_deploy[code] = "if test $(mount | grep "on / type" | sed -e "s/ on.*//" -e "s,^/dev/.*,/dev/,") != "/dev/"; then MNT_BASE=${TEMP_DIR}/flashimg/$(cat /sys/class/net/eth0/address | sed -e "s/://g"); fi"

UPDATABLE_BUNDLE_HOOK_appboot[type] = "inline"
UPDATABLE_BUNDLE_HOOK_appboot[trigger] = "postdeploy postupdate"
UPDATABLE_BUNDLE_HOOK_appboot[code] = "if test "${UPDATE_APP}" = Y; then mv ${MNT_BOOT}/${KERNEL_IMAGETYPE}-${MACHINE} ${MNT_BOOT}/${KERNEL_IMAGETYPE}; fi"

UPDATABLE_BUNDLE_HOOK_prepare_overlay[type] = "inline"
UPDATABLE_BUNDLE_HOOK_prepare_overlay[trigger] = "postdeploy"
UPDATABLE_BUNDLE_HOOK_prepare_overlay[code] = "mkdir -p ${MNT_DATA}/{${OVERLAY_SHADOWS}}"

UPDATABLE_BUNDLE_HOOK_uboot_setenv[type] = "inline"
UPDATABLE_BUNDLE_HOOK_uboot_setenv[code] = 'test "${INTERNAL_ROOT_DEV}" = "${WANTED_ROOT_DEV}" && fw_setenv sysimg_version ${DISTRO_VERSION}'

UPDATABLE_BUNDLE_SLOTS = "SPL TPL BOOTSCRIPT KERNEL DTB"

UPDATABLE_SLOT_SPL = "${PREFERRED_PROVIDER_virtual/bootloader}"
UPDATABLE_SLOT_SPL[type] = "boot"
UPDATABLE_SLOT_SPL[file] = "${SPL_BINARY}"
UPDATABLE_SLOT_SPL[dest] = "raw"
UPDATABLE_SLOT_SPL[offset] = "256;512"
UPDATABLE_SLOT_SPL[condition] = "require_update_uboot"
UPDATABLE_SLOT_SPL[hook] = "uboot_setenv"
UPDATABLE_SLOT_TPL = "${PREFERRED_PROVIDER_virtual/bootloader}"
UPDATABLE_SLOT_TPL[type] = "boot"
UPDATABLE_SLOT_TPL[file] = "u-boot-${MACHINE}.${UBOOT_SUFFIX}"
UPDATABLE_SLOT_TPL[dest] = "raw"
UPDATABLE_SLOT_TPL[offset] = "768"
UPDATABLE_SLOT_TPL[together] = "SPL"

UPDATABLE_PARTITION_BOOT[offset] = "1M"

UPDATABLE_SLOT_BOOTSCRIPT = "bootscript-${MACHINE}-${WANTED_ROOT_DEV}"
UPDATABLE_SLOT_BOOTSCRIPT[type] = "boot"
UPDATABLE_SLOT_BOOTSCRIPT[file] = "bootscript"
UPDATABLE_SLOT_BOOTSCRIPT[dest] = "/boot"
UPDATABLE_SLOT_BOOTSCRIPT[together] = "KERNEL"
UPDATABLE_SLOT_KERNEL = "${PREFERRED_PROVIDER_virtual/kernel}"
UPDATABLE_SLOT_KERNEL[type] = "boot"
UPDATABLE_SLOT_KERNEL[file] = "${KERNEL_IMAGETYPE}"
UPDATABLE_SLOT_KERNEL[rename] = "${KERNEL_IMAGETYPE}-${MACHINE}"
UPDATABLE_SLOT_KERNEL[dest] = "/boot"
UPDATABLE_SLOT_DTB = "${PREFERRED_PROVIDER_virtual/kernel}"
UPDATABLE_SLOT_DTB[type] = "boot"
UPDATABLE_SLOT_DTB[file] = "${KERNEL_DEVICETREE}"
UPDATABLE_SLOT_DTB[dest] = "/boot"
UPDATABLE_SLOT_DTB[together] = "KERNEL"

include conf/machine/include/updatable-container-default-spec.inc
```

## conf/machine/wendy.conf
```bitbake
include conf/machine/beaglebone-yocto.conf

UBOOT_MMC_DEV-emmc = "1"
UBOOT_MMC_DEV-sd = "0"
UBOOT_MMC_DEV = "${UBOOT_MMC_DEV-${WANTED_ROOT_DEV}}"

OVERLAY = "overlay"

KERNEL_MMC_DEV-emmc = "1"
KERNEL_MMC_DEV-sd = "0"
KERNEL_MMC_DEV = "${KERNEL_MMC_DEV-${WANTED_ROOT_DEV}}"

IMAGE_FSTYPES = "tar.bz2 squashfs-xz"

# + nfs ?
AVAIL_ROOT_DEVS = "usb sd emmc"
BOOTABLE_ROOT_DEVS = "${INTERNAL_ROOT_DEV} sd"
INTERNAL_ROOT_DEV = "emmc"
WANTED_ROOT_DEV ??= "${INTERNAL_ROOT_DEV}"

ROOT_DEV_NAME-emmc = "mmcblk${KERNEL_MMC_DEV-emmc}"
ROOT_DEV_SEP-emmc = "p"
ROOT_DEV_TYPE-emmc = "ssd"
ROOT_DEV_NAME-sd = "mmcblk${KERNEL_MMC_DEV-sd}"
ROOT_DEV_SEP-sd = "p"
ROOT_DEV_TYPE-sd = "ssd"
ROOT_DEV_NAME-usb = "sda"
ROOT_DEV_SEP-usb = ""
ROOT_DEV_TYPE-usb = "ssd"

ROOT_DEV_NAME = "${ROOT_DEV_NAME-${WANTED_ROOT_DEV}}"
ROOT_DEV_SEP = "${ROOT_DEV_SEP-${WANTED_ROOT_DEV}}"
ROOT_DEV_TYPE = "${ROOT_DEV_TYPE-${WANTED_ROOT_DEV}}"

# according to http://processors.wiki.ti.com/index.php/Linux_Core_U-Boot_User's_Guide#Updating_an_SD_card_or_eMMC_with_RAW_writes
SERIAL_CONSOLES = "115200;ttyS0"
UBOOT_MACHINE = "am335x_boneblack_vboot_defconfig"
PRIMARY_SPL_OFFSET="256"
SECONDARY_SPL_OFFSET="512"
PRIMARY_UBOOT_OFFSET="768"
BOOTLOADER_RESERVED_SPACE="4096"
UBOOT_ENTRYPOINT = "0x82000000"
KERNEL_DEVICETREE = "am335x-boneblack.dtb"
UBOOT_LOADADDRESS = "${UBOOT_ENTRYPOINT}"
BOOTLOADER_FILES = "u-boot-${MACHINE}.${UBOOT_SUFFIX} ${SPL_BINARY}"

PACKAGE_EXTRA_ARCHS_append = " wendy-emmc wendy-sd wendy-usb wendy-nfs"
MACHINE_FEATURES_remove = " bluetooth phone irda usbgadget 3g nfc pci apm acpi pcmcia touchscreen wifi"
MACHINE_FEATURES_append = " usbhost alsa"

DEFAULT_ETH_DEV = "eth0"
#DEFAULT_WIFI_DEV = "wlan0"

SOC_FAMILY = "am335x:wendy"

PREFERRED_PROVIDER_virtual/bootloader = "u-boot"
PREFERRED_PROVIDER_virtual/kernel = "linux-${MACHINE}"
PREFERRED_VERSION_linux-wendy ?= "5.4%"
```
